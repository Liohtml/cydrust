## firmware/sdkconfig.defaults
```kconfig
# Increase main task stack — default 3584 bytes is too small for our render loop
CONFIG_ESP_MAIN_TASK_STACK_SIZE=32768

# ─────────────────────────────────────────────────────────────────────────────
# OTA build notes (cargo +esp build --features wifi,ota)
# ─────────────────────────────────────────────────────────────────────────────
# The default (USB / corporate) build keeps the single-`factory` partition
# layout, so the settings ABOVE are all it needs. Do NOT add the OTA options
# here — that would change the partition table for every build and break the
# plain USB flash.
#
# To build the OTA image, layer the extra sdkconfig file on top of this one by
# pointing the embuild env var at BOTH (semicolon-separated), e.g. in PowerShell:
#
#   $env:CARGO_TARGET_DIR='C:\t'
#   $env:ESP_IDF_SDKCONFIG_DEFAULTS='sdkconfig.defaults;sdkconfig.defaults.ota'
#   cargo +esp build --features wifi,ota
#
# `sdkconfig.defaults.ota` (committed alongside this file) contains:
#   CONFIG_PARTITION_TABLE_CUSTOM=y
#   CONFIG_PARTITION_TABLE_CUSTOM_FILENAME="partitions_ota.csv"
#   CONFIG_MBEDTLS_CERTIFICATE_BUNDLE=y          # esp_crt_bundle_attach (HTTPS)
#   CONFIG_MBEDTLS_CERTIFICATE_BUNDLE_DEFAULT_FULL=y
#   CONFIG_BOOTLOADER_APP_ROLLBACK_ENABLE=y      # optional safety: auto-rollback
#
# Alternatively flash the OTA partition table once with espflash directly:
#   espflash partition-table partitions_ota.csv --to-binary -o ota-pt.bin
#   espflash write-bin 0x8000 ota-pt.bin
# (and flash the app image to ota_0 @ 0x20000 instead of factory @ 0x10000).
```

## firmware/sdkconfig.defaults.ble
```kconfig
# Extra sdkconfig layer for the BLE build ONLY.
#
# Layer this ON TOP of sdkconfig.defaults — do not use it alone. NOTE: with the
# embuild/esp-idf-sys in this project, ESP_IDF_SDKCONFIG_DEFAULTS entries must be
# ABSOLUTE paths — relative paths are silently dropped and the BT options never
# reach the IDF build (you'll get "ble_gap_conn_find not found in esp_idf_sys",
# i.e. NimBLE headers were never compiled). In PowerShell:
#
#   $b = (Resolve-Path 'sdkconfig.defaults').Path
#   $l = (Resolve-Path 'sdkconfig.defaults.ble').Path
#   $env:ESP_IDF_SDKCONFIG_DEFAULTS = "$b;$l"
#   cargo +esp clean -p esp-idf-sys   # force the IDF reconfigure to pick it up
#   cargo +esp build --features ble
#
# Verify it applied by grepping the merged sdkconfig for CONFIG_BT_NIMBLE_ENABLED:
#   C:\t\xtensa-esp32-espidf\debug\build\esp-idf-sys-*\out\sdkconfig
#
# TOOLCHAIN CAVEAT: esp32-nimble 0.9/0.10 (the versions compatible with our
# esp-idf-svc 0.50) use the removed `#![feature(inline_const_pat)]` and will NOT
# compile on rustc 1.95+. See the esp32-nimble pin comment in Cargo.toml.
#
# The default USB build must NOT reference this file, so the Bluetooth
# controller / NimBLE host stay disabled there (no flash/RAM cost, byte-for-byte
# unchanged behaviour).

# Enable the Bluetooth controller and the NimBLE host stack (BLE only).
CONFIG_BT_ENABLED=y
CONFIG_BT_NIMBLE_ENABLED=y

# BLE-only: free the Classic-BT controller memory (the CYD's ESP32 supports BR/EDR
# but we never use it). Keeps the BLE-only build smaller.
CONFIG_BTDM_CTRL_MODE_BLE_ONLY=y
CONFIG_BTDM_CTRL_MODE_BR_EDR_ONLY=n
CONFIG_BTDM_CTRL_MODE_BTDM=n

# A single central (phone / PC relay) connects at a time; one slot is plenty and
# trims the NimBLE host's RAM footprint.
CONFIG_BT_NIMBLE_MAX_CONNECTIONS=1

# ─────────────────────────────────────────────────────────────────────────────
# FLASH / PARTITION NOTE
# ─────────────────────────────────────────────────────────────────────────────
# The NimBLE host + BT controller add a large chunk of flash (~ several hundred
# KiB) to the app image. The DEFAULT single-`factory` partition layout
# (sdkconfig.defaults, factory @ 0x10000) on most CYD modules is 0x100000 (1 MiB)
# or larger and comfortably fits firmware + NimBLE in release (`opt-level="s"`).
# If the linker reports the app does not fit the factory partition, enlarge the
# factory partition with a custom partition table, e.g.:
#
#   CONFIG_PARTITION_TABLE_CUSTOM=y
#   CONFIG_PARTITION_TABLE_CUSTOM_FILENAME="partitions_ble.csv"
#
# with a >=1.5 MiB factory app partition. This is NOT enabled by default here so
# the BLE build keeps the same flash map as the USB build unless you hit the
# size limit.
```

## firmware/sdkconfig.defaults.ota
```kconfig
# Extra sdkconfig layer for the OTA build ONLY.
#
# Layer this ON TOP of sdkconfig.defaults — do not use it alone:
#   $env:ESP_IDF_SDKCONFIG_DEFAULTS='sdkconfig.defaults;sdkconfig.defaults.ota'
#   cargo +esp build --features wifi,ota
#
# The default USB build must NOT reference this file, so its single-`factory`
# partition layout is preserved.

# Use the dual-slot OTA partition table (ota_0 / ota_1 + otadata).
CONFIG_PARTITION_TABLE_CUSTOM=y
CONFIG_PARTITION_TABLE_CUSTOM_FILENAME="partitions_ota.csv"

# HTTPS for the OTA download: bundle the Mozilla root CAs so that
# esp_crt_bundle_attach() can validate the firmware server's certificate.
CONFIG_MBEDTLS_CERTIFICATE_BUNDLE=y
CONFIG_MBEDTLS_CERTIFICATE_BUNDLE_DEFAULT_FULL=y

# Optional but recommended: if the freshly-booted image never calls
# ota::mark_valid(), the bootloader rolls back to the previous slot. Our call
# site marks the slot valid right after a clean WiFi connect.
CONFIG_BOOTLOADER_APP_ROLLBACK_ENABLE=y
```
